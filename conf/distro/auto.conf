## conf/machine/include/qcs405.inc
```bitbake
BASEMACHINE ?= "qcs405"
require conf/machine/include/basemachine.inc

#To BE CHANGED ONCE VT IS READY
SOC_FAMILY ?= "mdm9x07"
include conf/machine/include/soc-family.inc

# Pull in security flags
require ${COREBASE}/meta-qti-bsp/conf/distro/include/security_flags.inc

include conf/machine/include/arm/arch-armv8.inc

# TODO: preferred kernel will be linux-msm_4.14"
PREFERRED_PROVIDER_virtual/kernel = "linux-msm"
PREFERRED_VERSION_linux-msm = "4.9"

MACHINE_DISPLAY_WIDTH_PIXELS ?= "480"
MACHINE_DISPLAY_HEIGHT_PIXELS ?= "640"

SERIAL_CONSOLE ?= "${@['', '115200 ttyHSL0'][d.getVar('VARIANT', True) == ('' or 'debug')]}"

DISTRO ?= "msm"

DISTRO_FEATURES_append = " ro-rootfs"

PAGE_SIZE ?= '4096'

MACHINE_FEATURES += "kernel26 keyboard"

# TODO: ADD qcs405 entries, once kernel is ready.
KERNEL_DTS_NAME = "sdxpoorwills"
KERNEL_BASE = "0x80000000"
KERNEL_TAGS_OFFSET = "0x82000000"
KERNEL_DEFCONFIG = "sdxpoorwills_defconfig"
KERNEL_PERF_DEFCONFIG = "sdxpoorwills-perf_defconfig"

KERNEL_CMD_PARAMS = "noinitrd rw rootwait console=ttyMSM0,115200,n8 no_console_suspend=1 androidboot.hardware=qcom androidboot.console=ttyMSM0 lpm_levels.sleep_disabled=1"
```

## conf/machine/include/qcs605.inc
```bitbake
BASEMACHINE ?= "qcs605"
require conf/machine/include/basemachine.inc

SOC_FAMILY ?= "sdm670"
include conf/machine/include/soc-family.inc

require conf/machine/include/arm/arch-armv8.inc

BBMASK = ".*/*/recipes-kernel/linux-msm-4.4"
BBMASK .= "|.*/*/recipes-kernel/linux-quic"

SERIAL_CONSOLE = "115200 ttyMSM0"

DISTRO ?= "msm"

DISTRO_FEATURES += "persist-image"

PAGE_SIZE ?= '4096'

# Max supported inodes
EXTRA_IMAGECMD ?= "-N 2048"

# Sizes for EXT4 (in bytes)
SYSTEM_SIZE_EXT4 ?= "3000000000"
SYSTEMRW_SIZE_EXT4 ?= "8388608"
USERDATA_SIZE_EXT4 ?= "5000000000"
CACHE_SIZE_EXT4 ?= "65536000"

# Enable LE Verified Boot
DISTRO_FEATURES_append = " vble"

#Enable SDK feature
#SDK_IMAGE ?= "1"

#Enable Recovery image generation
RECOVERY_IMAGE ?= "1"

# Formats of root filesystem images.
IMAGE_FSTYPES += "ext4"
```

## conf/machine/include/sdm710.inc
```bitbake
BASEMACHINE ?= "sdm710"
require conf/machine/include/basemachine.inc

SOC_FAMILY ?= "warlock"
include conf/machine/include/soc-family.inc

# Pull in security flags
require ${COREBASE}/meta-qti-bsp/conf/distro/include/security_flags.inc

require conf/machine/include/arm/arch-armv8.inc

PREFERRED_PROVIDER_virtual/kernel = "linux-msm"
PREFERRED_VERSION_linux-msm = "4.17"

MACHINE_DISPLAY_WIDTH_PIXELS ?= "480"
MACHINE_DISPLAY_HEIGHT_PIXELS ?= "640"
#CONFIG_BUILD_ARM64_DT_OVERLAY = y

SERIAL_CONSOLE ?= "${@['', '115200 ttyMSM0'][d.getVar('VARIANT', True) == ('' or 'debug')]}"

DISTRO ?= "msm"

MACHINE_FEATURES += "kernel26 keyboard"

PAGE_SIZE ?= '4096'

# Max supported inodes
EXTRA_IMAGECMD ?= "-N 2048"

# Sizes for EXT4 (in bytes)
SYSTEM_SIZE_EXT4 ?= "3000000000"
USERDATA_SIZE_EXT4 ?= "5000000000"
CACHE_SIZE_EXT4 ?= "65536000"
RECOVERYFS_SIZE_EXT4 ?= "136000000"

# Multilib configuration
# This sets any packages preprended with lib32- to be built with
# the armv7a tuning (32 bit) instead of 64 bit aarch.
require conf/multilib.conf
MULTILIBS = "multilib:lib32"
DEFAULTTUNE_virtclass-multilib-lib32 = "armv7a-neon"

# Formats of root filesystem images.
IMAGE_FSTYPES += "ext4"
```

## conf/machine/mdm9607.conf
```bitbake
#@TYPE: Machine
#@NAME: MDM9607 CDP
#@DESCRIPTION: Machine configuration for QTI MDM9607 CDP

require conf/machine/include/mdm9607.inc

KERNEL_IMAGETYPE = "zImage"
KERNEL_DTS_NAME = "mdm9607"
KERNEL_BASE = "0x80000000"
KERNEL_TAGS_OFFSET = "0x81E00000"
KERNEL_DEFCONFIG = "${@bb.utils.contains('PRODUCT', 'psm', 'mdm9607-128mb-perf_defconfig', 'mdm9607_defconfig', d)}"
KERNEL_PERF_DEFCONFIG = "mdm9607-perf_defconfig"
KERNEL_CMD_PARAMS = "noinitrd ro console=ttyMSM0,115200,n8 androidboot.hardware=qcom ehci-hcd.park=3 msm_rtb.filter=0x37 lpm_levels.sleep_disabled=1 earlycon=msm_serial_dm,0x78b3000"

#Enable Recovery image generation
RECOVERY_IMAGE = "1"
```

## conf/machine/mdm9650.conf
```bitbake
#@TYPE: Machine
#@NAME: MDMCALIFORNIUM
#@DESCRIPTION: Machine configuration for QTI MDMCALIFORNIUM MTP

require conf/machine/include/mdm9650.inc

KERNEL_IMAGETYPE = "zImage"
KERNEL_DTS_NAME = "mdm9650"
KERNEL_BASE = "0x80000000"
KERNEL_TAGS_OFFSET = "0x82000000"
KERNEL_DEFCONFIG = "mdm_defconfig"
KERNEL_PERF_DEFCONFIG = "mdm-perf_defconfig"
KERNEL_CMD_PARAMS = "noinitrd ro console=ttyMSM0,115200,n8 androidboot.hardware=qcom ehci-hcd.park=3 msm_rtb.filter=0x37 lpm_levels.sleep_disabled=1 earlycon=msm_serial_dm,0x78b1000"

#GCCVERSION = "5.2%"
#Enable Recovery image generation
RECOVERY_IMAGE = "1"
```

## conf/machine/qcs403-som2.conf
```bitbake
#@TYPE: Machine
#@NAME: SOM2-QCS403
#@DESCRIPTION: Machine configuration for QTI SOM2-QCS403
require conf/machine/include/qcs40x.inc
# NAND TARGET TO SUPPORT 32-bit kernel
DISTRO = "qsap"
DISTRO_FEATURES += "nand-boot"
PAGE_SIZE ?= '4096'
USR_IMAGE_BASENAME       = "${BASEMACHINE}-usrfs"
OUTPUT_FILE_FINAL_UBI    = "${DEPLOY_DIR_IMAGE}/${BASEMACHINE}-sysfs.ubi"
# Max supported inodes
EXTRA_IMAGECMD ?= "-N 2048"
#UBINIZE Args
UBINIZE_ARGS ?= "-m 4096 -p 256KiB -s 4096"
#MKUBIFS Args
MKUBIFS_ARGS ?= "-m 4096 -e 253952 -c 2146 -F"
#Volume sizes
SYSTEM_VOLUME_SIZE ?= "150MiB"
CACHE_VOLUME_SIZE ?= "20MiB"
SYSTEMRW_VOLUME_SIZE ?= "6MiB"

# Formats of root filesystem images.
IMAGE_FSTYPES += "ubi"

# enable audio as a loadable kernel module
DISTRO_FEATURES_append = " audio-dlkm"

DEFAULTTUNE = "armv7ahf-neon"

RECOVERY_IMAGE = "0"

KERNEL_IMAGETYPE = "zImage-dtb"

#Need for compiling UEFI for aarch64
require conf/multilib.conf
MULTILIBS = "multilib:lib64"
DEFAULTTUNE_virtclass-multilib-lib64 = "aarch64"

PREFERRED_PROVIDER_virtual/libgles1 = "adreno"
PREFERRED_PROVIDER_virtual/libgles2 = "adreno"
PREFERRED_PROVIDER_virtual/egl      = "adreno"
```

## conf/machine/qcs405-32.conf
```bitbake
#@TYPE: Machine
#@NAME: QCS405-32
#@DESCRIPTION: Machine configuration for QTI QCS405-32
require conf/machine/include/qcs405.inc
# NAND TARGET TO SUPPORT 32-bit kernel
DISTRO ?= "msm"
DISTRO_FEATURES += "nand-boot"
PAGE_SIZE ?= '4096'

# Max supported inodes
EXTRA_IMAGECMD ?= "-N 2048"
#UBINIZE Args
UBINIZE_ARGS ?= "-m 4096 -p 256KiB -s 4096"
#MKUBIFS Args
MKUBIFS_ARGS ?= "-m 4096 -e 253952 -c 2146 -F"
#Volume sizes
SYSTEM_VOLUME_SIZE ?= "16MiB"
CACHE_VOLUME_SIZE ?= "20MiB"
SYSTEMRW_VOLUME_SIZE ?= "1MiB"

# Formats of root filesystem images.
IMAGE_FSTYPES += "ubi"

DEFAULTTUNE = "armv7ahf-neon"

RECOVERY_IMAGE = "1"

KERNEL_IMAGETYPE = "zImage-dtb"

#Need for compiling UEFI for aarch64
require conf/multilib.conf
MULTILIBS = "multilib:lib64"
DEFAULTTUNE_virtclass-multilib-lib64 = "aarch64"
```

## conf/machine/qcs405-64.conf
```bitbake
#@TYPE: Machine
#@NAME: QCS405-64
#@DESCRIPTION: Machine configuration for QTI QCS405-64
require conf/machine/include/qcs405.inc
# EMMC TARGET TO SUPPORT 64-bit kernel
DISTRO ?= "msm"
DEFAULTTUNE = "aarch64"

# Sizes for EXT4 (in bytes)
SYSTEM_SIZE_EXT4 ?= "100000000"
SYSTEMRW_SIZE_EXT4 ?= "8388608"
USERDATA_SIZE_EXT4 ?= "2000000000"
CACHE_SIZE_EXT4 ?= "80000000"

# Formats of root filesystem images.
IMAGE_FSTYPES += "ext4"
RECOVERY_IMAGE = "1"

# Use systemd init manager.
DISTRO_FEATURES_remove = "sysvinit"
DISTRO_FEATURES_append = " systemd"
DISTRO_FEATURES_BACKFILL_CONSIDERED += "sysvinit"
VIRTUAL-RUNTIME_dev_manager = "udev"
VIRTUAL-RUNTIME_init_manager = "systemd"

# Change Image features for systemd.
IMAGE_DEV_MANAGER = "udev"
IMAGE_INIT_MANAGER = "systemd"
IMAGE_INITSCRIPTS = ""

KERNEL_IMAGETYPE = "Image.gz-dtb"
IMAGE_EXT4_EXTRA_OPTIONS = "${@bb.utils.contains('DISTRO_FEATURES','ro-rootfs',' -J -b 1024 ','',d)}"

#  TODO: ADD qcs405 entries, once kernel is ready.
KERNEL_DTS_NAME = "qcs605"
KERNEL_BASE = "0x80000000"
KERNEL_TAGS_OFFSET = "0x81900000"
KERNEL_DEFCONFIG = "sdm670_defconfig"
KERNEL_CMD_PARAMS = "console=ttyMSM0,115200n8 earlycon=msm_geni_serial,0xA84000 androidboot.hardware=qcom androidboot.console=ttyMSM0 video=vfb:640x400,bpp=32,memsize=3072000 msm_rtb.filter=0x237 ehci-hcd.park=3 lpm_levels.sleep_disabled=1 service_locator.enable=1 androidboot.selinux=permissive"
```

## conf/machine/qcs405-som1.conf
```bitbake
#@TYPE: Machine
#@NAME: SOM1-QCS405
#@DESCRIPTION: Machine configuration for QTI SOM1-QCS405
require conf/machine/include/qcs40x.inc
# EMMC TARGET TO SUPPORT 64-bit kernel
DISTRO = "qsap"
DEFAULTTUNE = "aarch64"

# Sizes for EXT4 (in bytes)
SYSTEM_SIZE_EXT4 ?= "681574400"
SYSTEMRW_SIZE_EXT4 ?= "8388608"
USERDATA_SIZE_EXT4 ?= "2000000000"
CACHE_SIZE_EXT4 ?= "80000000"

# enable audio as a loadable kernel module
DISTRO_FEATURES_append = " audio-dlkm"

#enable selinux
DISTRO_FEATURES_append = " selinux"
DEFAULT_ENFORCING = "enforcing"

# Formats of root filesystem images.
IMAGE_FSTYPES += "ext4"
RECOVERY_IMAGE = "0"

KERNEL_IMAGETYPE = "Image.gz-dtb"
IMAGE_EXT4_EXTRA_OPTIONS = "${@bb.utils.contains('DISTRO_FEATURES','ro-rootfs',' -J -b 4096 ','',d)}"
DISTRO_FEATURES += "persist-image"
require conf/multilib.conf
MULTILIBS = "multilib:lib32"
DEFAULTTUNE_virtclass-multilib-lib32 = "armv7ahf-neon"
TARGET_VENDOR_virtclass-multilib-lib32="-oe"

PREFERRED_PROVIDER_virtual/libgles1 = "adreno"
PREFERRED_PROVIDER_virtual/libgles2 = "adreno"
PREFERRED_PROVIDER_virtual/egl      = "adreno"

DISTRO_FEATURES += "ab-boot-support"
```
