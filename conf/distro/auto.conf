## conf/distro/auto.conf
```bitbake
BASEDISTRO ?= "mdm"

require conf/distro/mdm.conf

DISTRO_NAME = "auto"
DISTROOVERRIDES =. "${MACHINE}-auto:"

PRODUCT = "auto"

KERNEL_CONFIG = "${@['${MACHINE}-auto-perf_defconfig', '${MACHINE}-auto_defconfig'][d.getVar('VARIANT', True) == ('' or 'debug')]}"

DISTRO_FEATURES += "early-eth"
DISTRO_FEATURES += " selinux"
DISTRO_FEATURES_FILTER_NATIVE  += " selinux"
DEFAULT_ENFORCING = "enforcing"

#Volume sizes
SYSTEM_VOLUME_SIZE = "90MiB"
CACHE_VOLUME_SIZE = "100MiB"
SYSTEMRW_VOLUME_SIZE = "6MiB"
PERSIST_VOLUME_SIZE = "6MiB"

# Formats of root filesystem images.
IMAGE_FSTYPES = "ubi"
```

## conf/distro/batcam.conf
```bitbake
# batcam is a derivative of concam.
BASEDISTRO ?= "concam"
require conf/distro/concam.conf

DISTRO_NAME = "batcam"
DISTROOVERRIDES =. "batcam:"

PRODUCT = "batcam"

# Hibernation Support
KERNEL_CMD_PARAMS_append = " resume=/dev/mmcblk0p25 resumewait no_console_suspend=1 "
```

## conf/distro/concam.conf
```bitbake
BASEDISTRO ?= "msm"
require conf/distro/msm.conf

DISTRO_NAME = "concam"
DISTROOVERRIDES =. "concam:"

#Enable verity feature
DISTRO_FEATURES += "dm-verity"
PRODUCT ?= "concam"
```

## conf/distro/include/base.inc
```bitbake
#############################################################################
#@COMMENT: This distribution configuration defines an OE Linux based
#@COMMENT: distribution. The matching buildable image target (machine-image)
#@COMMENT: basically consists of: libc, busybox, udev, sysv init, and a few
#@COMMENT: init scripts for running up the system on qti chipsets.
#############################################################################
BASEDISTRO ??= ""

# Add BASEDISTRO to overrides
DISTROOVERRIDES =. "${@['', '${BASEDISTRO}:']['${BASEDISTRO}' != '']}"

# DISTRO FEATURE SELECTION
MICRO_GOLD ?= "ld-is-gold"
MICRO_GOLD_apq8017 = ""

USE_DEVFS = "0"

# Use Debian naming scheme for library (.so) files
INHERIT += "recipe_sanity"

# TOOLCHAIN
PREFERRED_VERSION_autoconf = "2.68"
ARM_INSTRUCTION_SET       ?= "arm"

FULL_OPTIMIZATION          = "-O2 -Wa,--noexecstack -fexpensive-optimizations -frename-registers -fomit-frame-pointer -ftree-vectorize "
FULL_OPTIMIZATION         += " -finline-functions -finline-limit=64 "
# Ignore a few common warnings
FULL_OPTIMIZATION         += " -Wno-error=maybe-uninitialized -Wno-error=unused-result "

# NLS
USE_NLS = "no"
USE_NLS_glib-2.0 = "yes"
USE_NLS_glib-2.0-native = "yes"
USE_NLS_gcc-cross = "no"

# Disable binary locale generation
ENABLE_BINARY_LOCALE_GENERATION = "0"

#Allow library symlinks to exist alongside soname files
PACKAGE_SNAP_LIB_SYMLINKS = "0"

# Don't install ldconfig and associated gubbins
USE_LDCONFIG = "0"
LDCONFIGDEPEND = ""
COMMERCIAL_LICENSE_DEPENDEES = ""

PREFERRED_VERSION_readline = "5.2"

PRODUCT ??= "base"

# Retain existing directory structure for msm or mdm distro images.
# Append variants like '-perf', '-user' etc to deploy dir.
DEPLOY_NAME_BASE = "${MACHINE}${@bb.utils.contains_any('DISTRO', 'msm mdm', '', '-' + d.getVar('DISTRO'), d)}"
DEPLOY_NAME = "${DEPLOY_NAME_BASE}${@['-' + d.getVar('VARIANT', True), ''][d.getVar('VARIANT', True) == ('' or 'debug')]}"
DEPLOY_DIR_IMAGE = "${DEPLOY_DIR}/images/${DEPLOY_NAME}"

INHERIT += "extrausers"

EXTRA_USERS_PARAMS = "\
 useradd -u 1000 -U system; \
 useradd -u 1001 -U radio; \
 useradd -u 1002 -U bluetooth; \
 useradd -u 1003 -U graphics; \
 useradd -u 1004 -g input input; \
 useradd -u 1005 -g audio audio; \
 useradd -u 1006 -U camera;\
 useradd -u 1010 -U wifi; \
 useradd -u 1013 -U media; \
 useradd -u 1021 -U gps; \
 useradd -u 1036 -U logd;\
 useradd -u 2000 -U adb; \
 useradd -u 3011 -U sensors; \
 useradd -u 4000 -U apps; \
 useradd -u 4021 -U locclient; \
 useradd -u 9999 -U nobody; \
 useradd -u 5000 -U qmmfsvr; \
 useradd -u 5001 -U qmmfwebsvr; \
 useradd -u 5002 -U leprop; \
 usermod -L -e 1 system; \
 usermod -L -e 1 radio; \
 usermod -L -e 1 bluetooth; \
 usermod -L -e 1 graphics; \
 usermod -L -e 1 input; \
 usermod -L -e 1 audio; \
 usermod -L -e 1 camera; \
 usermod -L -e 1 wifi; \
 usermod -L -e 1 media; \
 usermod -L -e 1 adb; \
 usermod -L -e 1 sensors; \
 usermod -L -e 1 apps; \
 usermod -L -e 1 adb; \
 usermod -L -e 1 sensors; \
 usermod -L -e 1 Apps; \
 usermod -L -e 1 nobody; \
 usermod -L -e 1 qmmfsvr; \
 usermod -L -e 1 qmmfwebsvr; \
 usermod -L -e 1 leprop; \
 usermod -L -e 1 logd; \
 usermod -a -G system,inet,leprop qmmfwebsvr; \
 usermod -a -G system,leprop qmmfsvr; \
 usermod -a -G diag,inet,system,leprop sensors; \
 usermod -a -G inet,system,leprop camera; \
 usermod -a -G leprop bluetooth; \
 usermod -a -G system,gps,locclient gps; \
 groupadd -g 3005 net_admin; \
 groupadd -g 3009 readproc; \
 groupadd -g 3010 wakelock; \
"

EXTRA_USERS_PARAMS_append = " ${@['', 'usermod -L -e 1 root;'][d.getVar('VARIANT', True) == 'user']}"
```

## conf/distro/mdm-perf.conf
```bitbake
###############################################################################################
#@TYPE: Distribution
#@NAME: MDM-PERF
#@DESCRIPTION: QTI Linux Distribution for MDM targets with performance orientation (glibc based)
################################################################################################
INHERIT += "extrausers"

require conf/distro/include/msm.inc

# DISTRO CONFIGURATION
DISTRO_NAME = "mdm-perf"
DISTRO_VERSION = "${BUILDNAME}"
VIRTUAL-RUNTIME_dev_manager ?= "busybox-mdev"

# Add mdm-perf to distro overrides
DISTROOVERRIDES = "mdm:mdm-perf"

# Basic distribution features
DISTRO_FEATURES += "sysvinit eabi ipv6 ipv4 largefile thumb-interwork xattr ld-is-gold ${DISTRO_FEATURES_LIBC}"

# MDMs are NAND based targets
DISTRO_FEATURES += "nand-boot"

# Enable performance features
PERF_BUILD = "1"

# Retain existing directory structure for base product image.
# Append variants like '-perf', '-user', '-minimal' etc to deploy dir.
DEPLOY_NAME ?= "${MACHINE}${@['-' + d.getVar('PRODUCT', True), ''][d.getVar('PRODUCT', True) == ('' or 'base')]}-perf"
DEPLOY_DIR_IMAGE = "${DEPLOY_DIR}/images/${DEPLOY_NAME}"
```

## conf/distro/msm.conf
```bitbake
#############################################################################
#@TYPE: Distribution
#@NAME: MSM
#@DESCRIPTION: MSM Linux Distribution (glibc based)
#############################################################################
INHERIT += "extrausers"
require conf/distro/include/msm.inc

# DISTRO CONFIGURATION
DISTRO_NAME = "msm"
DISTRO_VERSION = "${BUILDNAME}"
VIRTUAL-RUNTIME_dev_manager ?= "busybox-mdev"

# Add distro overrides
DISTROOVERRIDES = "msm"

# Basic distribution features
DISTRO_FEATURES += "sysvinit eabi ipv6 ipv4 largefile thumb-interwork xattr ${MICRO_GOLD} ${DISTRO_FEATURES_LIBC}"

# MSMs are emmc based targets
DISTRO_FEATURES += "emmc-boot"

# Retain existing directory structure for base product image.
# Append variants like '-perf', '-user', 'perf-minimal' etc to deploy dir.
DEPLOY_NAME ?= "${MACHINE}${@['-' + d.getVar('PRODUCT', True), ''][d.getVar('PRODUCT', True) == ('' or 'base')]}${@['-' + d.getVar('VARIANT', True), ''][d.getVar('VARIANT', True) == ('')]}"
DEPLOY_DIR_IMAGE = "${DEPLOY_DIR}/images/${DEPLOY_NAME}"

EXTRA_USERS_PARAMS = "\
 useradd -u 1000 -U system; \
 useradd -u 1001 -U radio; \
 useradd -u 1002 -U bluetooth; \
 useradd -u 1003 -U graphics; \
 useradd -u 1004 -g input input; \
 useradd -u 1005 -g audio audio; \
 useradd -u 1006 -U camera;\
 useradd -u 2000 -U adb; \
 useradd -u 3011 -U sensors; \
 useradd -u 4000 -U apps; \
 useradd -u 9999 -U nobody; \
 usermod -L -e 1 system; \
 usermod -L -e 1 radio; \
 usermod -L -e 1 bluetooth; \
 usermod -L -e 1 graphics; \
 usermod -L -e 1 input; \
 usermod -L -e 1 audio; \
 usermod -L -e 1 camera; \
 usermod -L -e 1 adb; \
 usermod -L -e 1 sensors; \
 usermod -L -e 1 Apps; \
 usermod -L -e 1 nobody; \
"
```

## conf/distro/psm.conf
```bitbake
BASEDISTRO ?= "psm"
require conf/distro/mdm.conf

DISTRO_NAME = "psm"
DISTROOVERRIDES =. "psm:"

PRODUCT = "psm"
```

## conf/distro/robot-som-ros.conf
```bitbake
BASEDISTRO ?= "robot"
require conf/distro/msm.conf
DISTRO_NAME = "robot-som-ros"
DISTROOVERRIDES =. "robot-som-ros:"

PRODUCT = "robot-som"

#Ros needs larger system size
SYSTEM_SIZE_EXT4 = "838860800"
RECOVERY_IMAGE = "0"

PREFERRED_VERSION_v4l-utils = "1.6.2"

KERNEL_DTS_NAME = "*8*09"

KERNEL_CMD_PARAMS = "noinitrd ro console=ttyMSM0,115200,n8 androidboot.hardware=qcom ehci-hcd.park=3 msm_rtb.filter=0x37 lpm_levels.sleep_disabled=1 rootwait androidboot.bootdevice=7824900.sdhci mem=512M"

PREFERRED_VERSION_linux-msm = "4.9"

SERIAL_CONSOLE = "115200 ttyMSM0"

# enable audio as a loadable kernel module
DISTRO_FEATURES_append = " audio-dlkm"

DISTRO_FEATURES_append = " ab-boot-support"
```

## conf/distro/robot-som.conf
```bitbake
BASEDISTRO ?= "robot"
require conf/distro/msm.conf
DISTRO_NAME = "robot-som"
DISTROOVERRIDES =. "robot-som:"

PRODUCT = "robot-som"
```

## conf/distro/robot.conf
```bitbake
BASEDISTRO ?= "msm"
require conf/distro/msm.conf

DISTRO_NAME = "robot"
DISTROOVERRIDES =. "robot:"

PRODUCT ?= "robot"
```

## conf/layer.conf
```bitbake
BBFILES += "${LAYERDIR}/recipes/*/*.bb ${LAYERDIR}/recipes/*/*.bbappend ${LAYERDIR}/recipes-*/*/*.bb ${LAYERDIR}/recipes-*/*/*.bbappend"
BBPATH .= ":${LAYERDIR}"
BBFILE_COLLECTIONS += "msm"
BBFILE_PRIORITY_msm = "10"
BBFILE_PATTERN_msm := "^${LAYERDIR}/"

# Tools needed on the build host for usage within build tasks by recipes of this layer.
HOSTTOOLS_NONFATAL += "xgettext msgmerge msgfmt gmsgfmt java zip"
```

## conf/machine/apq8053-32.conf
```bitbake
#@TYPE: Machine
#@NAME: APQ8053-32
#@DESCRIPTION: 32-bit Machine configuration for QTI MTP with APQ8053

require conf/machine/include/apq8053.inc

DEFAULTTUNE = "armv7a-neon"

PREFERRED_PROVIDER_virtual/kernel = "linux-msm-4.9"
PREFERRED_PROVIDER_virtual/bootloader = "lk"

KERNEL_IMAGETYPE = "zImage-dtb"
KERNEL_DTS_NAME = "msm8953"
KERNEL_BASE = "0x80000000"
KERNEL_TAGS_OFFSET = "0x81900000"
KERNEL_DEFCONFIG = "msm8953_defconfig"
KERNEL_CMD_PARAMS = "noinitrd ro console=ttyMSM0,115200,n8 androidboot.hardware=qcom ehci-hcd.park=3 msm_rtb.filter=0x37 lpm_levels.sleep_disabled=1 rootwait androidboot.bootdevice=7824900.sdhci"

# Perf kernel configs
KERNEL_PERF_IMAGETYPE = "zImage-dtb"
KERNEL_PERF_DEFCONFIG = "msm8953-perf_defconfig"
KERNEL_PERF_CMD_PARAMS = "noinitrd ro androidboot.hardware=qcom ehci-hcd.park=3 msm_rtb.filter=0x37 lpm_levels.sleep_disabled=1 rootwait androidboot.bootdevice=7824900.sdhci"

# readonly-rootfs
DISTRO_FEATURES_append = " ro-rootfs"
#enable selinux feature
DISTRO_FEATURES_append = " selinux"
DEFAULT_ENFORCING = "permissive"

# Use systemd init manager.
DISTRO_FEATURES_remove = "sysvinit"
DISTRO_FEATURES_append = " systemd"
DISTRO_FEATURES_BACKFILL_CONSIDERED += "sysvinit"
VIRTUAL-RUNTIME_dev_manager = "udev"
VIRTUAL-RUNTIME_init_manager = "systemd"
# Change Image features for systemd.
IMAGE_DEV_MANAGER = "udev"
IMAGE_INIT_MANAGER = "systemd"
IMAGE_INITSCRIPTS = ""

# Disable journalling for RO rootfs.
IMAGE_EXT4_EXTRA_OPTIONS = "${@bb.utils.contains('DISTRO_FEATURES','ro-rootfs',' -J -b 4096 ','',d)}"
```

## conf/machine/genericarmv8-64.conf
```bitbake
#@TYPE: Machine
#@NAME: GENERICARMv8-64
#@DESCRIPTION: Machine configuration for QTI MTP with GENERICARMv8-64

require conf/machine/include/genericarmv8-64.inc

KERNEL_IMAGETYPE = "Image.gz-dtb"
KERNEL_DTS_NAME = "cvm"
KERNEL_BASE = "0xA0000000"
KERNEL_TAGS_OFFSET = "0xA3280000"
KERNEL_CONFIG = "${@['genericarmv8-64_defconfig', 'genericarmv8-64_defconfig'][d.getVar('VARIANT', True) == ('' or 'debug')]}"

KERNEL_CMD_PARAMS = "console=ttyV1 root=/dev/vblock0 rootfstype=ext4 rootwait"

DISTRO_FEATURES_append = " ro-rootfs"
```

## conf/machine/include/apq8009.inc
```bitbake
BASEMACHINE ?= "apq8009"
require conf/machine/include/basemachine.inc

SOC_FAMILY ?= "msm8909"
include conf/machine/include/soc-family.inc

# Pull in security flags
require ${COREBASE}/meta-qti-bsp/conf/distro/include/security_flags.inc

DEFAULTTUNE ?= "armv7ahf-neon"

include conf/machine/include/tune-cortexa7.inc

BBMASK = ".*/*/recipes-kernel/linux-msm-4.4"
BBMASK .= "|.*/*/recipes-kernel/linux-msm-4.9"

MACHINE_DISPLAY_WIDTH_PIXELS ?= "480"
MACHINE_DISPLAY_HEIGHT_PIXELS ?= "640"

SERIAL_CONSOLE ?= "115200 ttyHSL0"

DISTRO ?="msm"

DISTRO_FEATURES += "persist-image"

MACHINE_FEATURES += "kernel26 keyboard"

PAGE_SIZE ?= '4096'

# Max supported inodes
EXTRA_IMAGECMD ?= "-N 2048"

# Sizes for EXT4 (in bytes)
SYSTEM_SIZE_EXT4 ?= "1258292000"
SYSTEMRW_SIZE_EXT4 ?= "8388608"
USERDATA_SIZE_EXT4 ?= "2000000000"
CACHE_SIZE_EXT4 ?= "65536000"

#Enable Recovery image generation
RECOVERY_IMAGE ?= "1"

# Formats of root filesystem images.
IMAGE_FSTYPES += "ext4"
```

## conf/machine/include/apq8053.inc
```bitbake
BASEMACHINE ?= "apq8053"
require conf/machine/include/basemachine.inc

SOC_FAMILY ?= "msm8953"
include conf/machine/include/soc-family.inc

# Pull in security flags
require ${COREBASE}/meta-qti-bsp/conf/distro/include/security_flags.inc

require conf/machine/include/arm/arch-armv8.inc

PREFERRED_PROVIDER_virtual/kernel = "linux-msm"
PREFERRED_VERSION_linux-msm = "4.9%"

PREFERRED_PROVIDER_virtual/egl ?= "adreno"
PREFERRED_PROVIDER_virtual/libgles1 ?= "adreno"
PREFERRED_PROVIDER_virtual/libgles2 ?= "adreno"

MACHINE_DISPLAY_WIDTH_PIXELS ?= "480"
MACHINE_DISPLAY_HEIGHT_PIXELS ?= "640"

SERIAL_CONSOLE ?= "${@['', '115200 ttyMSM0'][d.getVar('VARIANT', True) == ('' or 'debug')]}"

DISTRO ?= "msm"

# Change default jpeg provider to turbo jpeg
PREFERRED_PROVIDER_jpeg = "libjpeg-turbo"

# iproute2 bump version to 4.1.1
PREFERRED_VERSION_iproute2 = "4.1.1"

DISTRO_FEATURES += "persist-image"

MACHINE_FEATURES += "kernel26 keyboard"

PAGE_SIZE ?= '4096'

# Max supported inodes
EXTRA_IMAGECMD ?= "-N 2048"

# Sizes for EXT4 (in bytes)
SYSTEM_SIZE_EXT4 ?= "786432000"
SYSTEMRW_SIZE_EXT4 ?= "8388608"
USERDATA_SIZE_EXT4 ?= "3000000000"
CACHE_SIZE_EXT4 ?= "734003200"

# FEC_SIZE depends on SYSTEM_SIZE_EXT4; command: fec -s "<SYSTEM_SIZE>"
# If fec enable :  "6172672" ; fec disable : 0 bytes of image size
FEC_SIZE ?= "6172672"

# Enable LE Verified Boot
DISTRO_FEATURES_append = " vble"

#Enable SDK feature
SDK_IMAGE ?= "0"

#Enable Recovery image generation
RECOVERY_IMAGE ?= "0"

# Formats of root filesystem images.
IMAGE_FSTYPES += "ext4"

#Extra fsconfig related options for ota package generator scripts.
OTA_EXTRA_OPTS ?= "1"

# DISTRO_FEATURES += "ab-support"
```

## conf/machine/include/mdm9607.inc
```bitbake
BASEMACHINE ?= "mdm9607"
require conf/machine/include/basemachine.inc

SOC_FAMILY ?= "mdm9x07"
include conf/machine/include/soc-family.inc

#TCLIBC = "musl"

# Pull in security flags
require ${COREBASE}/meta-qti-bsp/conf/distro/include/security_flags.inc

require conf/machine/include/tune-cortexa8.inc

PREFERRED_PROVIDER_virtual/kernel = "linux-msm"
PREFERRED_VERSION_linux-msm = "4.9%"

BBMASK = ".*/*/recipes-devtools/mtd/"
#BBMASK .= "|.*/*/recipes-security/libselinux/"

MACHINE_DISPLAY_WIDTH_PIXELS ?= "480"
MACHINE_DISPLAY_HEIGHT_PIXELS ?= "640"

SERIAL_CONSOLE ?= "${@['', '115200 ttyMSM0'][d.getVar('VARIANT', True) == ('' or 'debug')]}"

DISTRO ?= "mdm"

MACHINE_FEATURES += "kernel26 keyboard"

PAGE_SIZE ?= '4096'

# Max supported inodes
EXTRA_IMAGECMD ?= "-N 2048"

#UBINIZE Args
UBINIZE_ARGS ?= "-m 4096 -p 256KiB -s 4096"
#MKUBIFS Arg
MKUBIFS_ARGS ?= "-m 4096 -e 253952 -c 2146 -F"
#Volume sizes
SYSTEM_VOLUME_SIZE ?= "74MiB"
CACHE_VOLUME_SIZE ?= "37MiB"
SYSTEMRW_VOLUME_SIZE ?= "6MiB"

# Formats of root filesystem images.
IMAGE_FSTYPES += "ubi"
```
