## meta-qti-base/conf/distro/bg.conf
```bitbake
require conf/distro/poky.conf
require conf/distro/include/security_flags.inc

DISTRO = "bg"
DISTRO_NAME = "BG core"

#Use gcc 9.2X 
GCCVERSION = "9.%"

#local config
PERF_BUILD = "${@['0', '1'][d.getVar('VARIANT', True) != ('' or 'debug')]}"
PRODUCT ?= "${BASEMACHINE}${DISTRO}"

#Support QTI internal integration system.
DEPLOY_NAME_BASE="${PRODUCT}-automotive"
DEPLOY_NAME = "${DEPLOY_NAME_BASE}${@['-' + d.getVar('VARIANT', True), ''][d.getVar('VARIANT', True) == ('' or 'debug')]}"
DEPLOY_DIR_IMAGE = "${DEPLOY_DIR}/images/${DEPLOY_NAME}"
IMAGE_NAME = "${IMAGE_BASENAME}-${PRODUCT}${IMAGE_VERSION_SUFFIX}"
IMAGE_LINK_NAME = "${IMAGE_BASENAME}-${PRODUCT}"
TCLIBCAPPEND = "-${TCLIBC}"

#Defines how BitBake handles situations where an appendfile (.bbappend) has nocorresponding recipe file (.bb)
BB_DANGLINGAPPENDS_WARNONLY = "yes"

#Can't be removed, as QTI recipes assume it exists
USERADDEXTENSION = "qpermissions"

# To avoid issues with the n0-container bbclass
export userdata = "/var/data"

#Not allow to have empty ${PN}-dev package 
ALLOW_EMPTY_${PN}-dev = "0"

#Prevents installation of all "recommended-only" packages
NO_RECOMMENDATIONS = "1"


#use systemd as init manager
PREFERRED_PROVIDER_udev-utils = "systemd"
VIRTUAL-RUNTIME_dev_manager = "udev"
VIRTUAL-RUNTIME_init_manager = "systemd"

#DISTRO_FEATURES configuration
DISTRO_FEATURES_remove = "\
    3g \
    alsa \
    bluetooth \
    bluez5 \
    ext2 \
    gobject-introspection-data \
    irda \
    multiarch \
    nfc \
    pam \
    pulseaudio \
    usbgadget \
    vulkan \
    wifi \
    x11 \
    zeroconf \
"

#Add systemd ab-boot-support as required
DISTRO_FEATURES_append = " systemd ab-boot-support"

#Disable ssd listener
DISTRO_FEATURES_append = " no-ssd-listener-support"

DISTRO_FEATURES_BACKFILL_CONSIDERED_append = " bluez5 gobject-introspection-data pulseaudio sysvinit"

#GPLv2 configuration
INCOMPATIBLE_LICENSE = "GPLv3 GPLv3+ LGPLv3 LGPLv3+"

WHITELIST_GPL-3.0 += "binutils"

#QA configuration
WARN_TO_ERROR_QA_append = " build-deps invalid-packageconfig pkgv-invalid unknown-configure-option" 

ERROR_QA_remove = "license-checksum"

# masking QA issues 
PACKAGE_DEBUG_SPLIT_STYLE = "debug-without-src"

ROOTFS_POSTPROCESS_COMMAND_remove = "license_create_manifest;"

#libdrm OSS version in poky
PREFERRED_VERSION_libdrm  = "2.4.1%"

#Enable persist-image
DISTRO_FEATURES_append = " persist-image "
PERSIST_IMAGE_ROOTFS_SIZE ?= "128M"

##################################################################
# Optimization flags.
##################################################################
COMMON_OPTIMIZATION = " \
  -Wa,--noexecstack -fexpensive-optimizations \
  -frename-registers -ftree-vectorize \
  -finline-functions -finline-limit=64 \
  -Wno-error=maybe-uninitialized -Wno-error=unused-result \
  "

FULL_OPTIMIZATION         = "-O2 -fomit-frame-pointer ${COMMON_OPTIMIZATION} "
DEBUG_OPTIMIZATION_append = " ${COMMON_OPTIMIZATION} "

#Disable "-enable-default-pie" option in the configuration of gcc
GCCPIE = ""

#Internal distro configuration in meta-qti-internal layer
include conf/distro/include/bg-internal.inc
```

## meta-qti-base/conf/distro/include/auto-common.inc
```bitbake
BASEDISTRO ?= "msm"
include conf/distro/msm.conf

DISTRO_NAME = "automotive"
DISTROOVERRIDES =. "automotive:"

PRODUCT ?= "${BASEMACHINE}" 
DEPLOY_NAME_BASE = "${PRODUCT}-automotive"
IMAGE_NAME = "${IMAGE_BASENAME}-${PRODUCT}${IMAGE_VERSION_SUFFIX}"
IMAGE_LINK_NAME = "${IMAGE_BASENAME}-${PRODUCT}"

# Support systemd-user-session
DISTRO_FEATURES_append = " pam"

# Display
DISTRO_FEATURES_append = " wayland"

#Disable ssd listener
DISTRO_FEATURES_append = " no-ssd-listener-support"

# Use synergy, disable bluez
DISTRO_FEATURES_BACKFILL_CONSIDERED += "bluez5 bluetooth"

#Enable persist-image
DISTRO_FEATURES_append = " persist-image "
PERSIST_IMAGE_ROOTFS_SIZE ?= "128M"

DISTRO_FEATURES_append = " early-eth"
#DISTRO_FEATURES_append = " early_init"
#DISTRO_FEATURES_append = " early_userspace"

DISTRO_FEATURES_append = " ab-boot-support"

# Use systemd init manager.
DISTRO_FEATURES_append = " systemd"
DISTRO_FEATURES_BACKFILL_CONSIDERED += "sysvinit"
VIRTUAL-RUNTIME_dev_manager = "udev"
VIRTUAL-RUNTIME_init_manager = "systemd"

DISTRO_FEATURES_append = " ipa3"

IMAGE_EXT4_EXTRA_OPTIONS = "${@bb.utils.contains('DISTRO_FEATURES','ro-rootfs',' -J -b 1024 ','',d)}"

INCOMPATIBLE_LICENSE = "GPL-3.0 LGPL-3.0 AGPL-3.0"

include ${DISTRO_INC_FILES}
```

## meta-qti-base/conf/distro/include/debug_flags.inc
```bitbake
# The debug build variant requires packages with symbol information for ease
# of on target debugging.
INHIBIT_PACKAGE_STRIP = "${@bb.utils.contains('DEBUG_BUILD', '1', '1', '', d)}"
INHIBIT_PACKAGE_DEBUG_SPLIT = "${@bb.utils.contains('DEBUG_BUILD', '1', '1', '', d)}"
PACKAGE_DEBUG_SPLIT_STYLE="${@bb.utils.contains('DEBUG_BUILD', '1', '.debug', '', d)}"

# binutils are required for analysis of binaries
IMAGE_INSTALL += "${@bb.utils.contains('DEBUG_BUILD', '1', 'binutils', '', d)}"
```

## meta-qti-base/conf/layer.conf
```bitbake
BBFILES += "${LAYERDIR}/recipes/*/*.bb ${LAYERDIR}/recipes/*/*.bbappend ${LAYERDIR}/recipes-*/*/*.bb ${LAYERDIR}/recipes-*/*/*.bbappend"
BBPATH .= ":${LAYERDIR}"
BBFILE_COLLECTIONS += "msm"
BBFILE_PRIORITY_msm = "10"
BBFILE_PATTERN_msm := "^${LAYERDIR}/"
LAYERSERIES_COMPAT_msm = "${LAYERSERIES_COMPAT_core}"

# Tools needed on the build host for usage within build tasks by recipes of this layer.
HOSTTOOLS_NONFATAL += "xgettext msgmerge msgfmt gmsgfmt java zip python python2"

QTI_METAPATH_BASE := '${@os.path.normpath("${LAYERDIR}/")}'
```

## meta-qti-base/conf/machine/include/auto-common.inc
```bitbake
include conf/machine/include/basemachine.inc

SOC_FAMILY ?= ""
include conf/machine/include/soc-family.inc

include conf/machine/include/arm/arch-arm64.inc

PREFERRED_PROVIDER_virtual/kernel = "linux-msm"
PREFERRED_VERSION_linux-msm = "4.14"

# Prefer tcpdump 4.9.x by default
PREFERRED_VERSION_tcpdump              ?= "4.9.%"

# Prefer Wayland/Weston version
PREFERRED_VERSION_weston = "5.0.0"
PREFERRED_VERSION_wayland = "1.18.0"
PREFERRED_VERSION_wayland-native = "1.18.0"
PREFERRED_VERSION_wayland-protocols = "1.20"
PREFERRED_VERSION_wayland-ivi-extension = "2.2.0"

# Prefer GStreamer 1.16.x by default
PREFERRED_VERSION_gstreamer1.0              ?= "1.16.%"
PREFERRED_VERSION_gstreamer1.0-plugins-bad  ?= "1.16.%"
PREFERRED_VERSION_gstreamer1.0-plugins-base ?= "1.16.%"
PREFERRED_VERSION_gstreamer1.0-plugins-good ?= "1.16.%"
PREFERRED_VERSION_gstreamer1.0-plugins-ugly ?= "1.16.%"
PREFERRED_VERSION_gstreamer1.0-libav        ?= "1.16.%"
PREFERRED_VERSION_gstreamer1.0-omx          ?= "1.16.%"

# Prefer adreno
PREFERRED_PROVIDER_virtual/wayland-egl  = "adreno"
PREFERRED_PROVIDER_virtual/egl          = "adreno"
PREFERRED_PROVIDER_virtual/libgles1     = "adreno"
PREFERRED_PROVIDER_virtual/libgles2     = "adreno"

# Prefer iproute2
PREFERRED_VERSION_iproute2         ?= "4.11"

PREFERRED_VERSION_libdrm  = "2.4.66"

LICENSE_FLAGS_WHITELIST += "commercial_gstreamer1.0-libav commercial_gstreamer1.0-omx"
LICENSE_FLAGS_WHITELIST += "commercial_gstreamer1.0-plugins-ugly commercial_opencore-amr"

MACHINE_DISPLAY_WIDTH_PIXELS ?= "480"
MACHINE_DISPLAY_HEIGHT_PIXELS ?= "640"

SERIAL_CONSOLE ?= "${@['', '115200 ttyMSM0'][d.getVar('VARIANT', True) == ('' or 'debug')]}"
SERIAL_CONSOLES = "115200;ttyMSM0"

# EXTRA_IMAGE_FEATURES = "tools-debug"

PAGE_SIZE ?= '4096'
IMAGE_ROOTFS_ALIGNMENT = "4096"
EXTRA_IMAGECMD_ext4 += " -b 4096 "

IMAGE_CLASSES += "qimage"

# Temporary disable these paths for yocto2.6 upgrade.
WARN_TO_ERROR_QA_remove += "unknown-configure-option"

GCCVERSION = "9.%"
```

## meta-qti-base/conf/machine/qtiquingvm.conf
```bitbake
#@TYPE: Machine
#@NAME: qtiquingvm
#@DESCRIPTION: Machine configuration for QTI QUIN

BASEMACHINE ?= "qtiquingvm"
include conf/machine/include/auto-common.inc
include conf/machine/include/bbmask.inc

SERIAL_CONSOLE = "115200 ttyAMA0"

# EMMC TARGET TO SUPPORT 64-bit kernel
DEFAULTTUNE = "aarch64"

# Sizes for EXT4 (in bytes)
SYSTEM_SIZE_EXT4 ?= "100000000"
SYSTEMRW_SIZE_EXT4 ?= "8388608"
USERDATA_SIZE_EXT4 ?= "2000000000"
CACHE_SIZE_EXT4 ?= "80000000"

# Rootfs size
IMAGE_ROOTFS_SIZE = "1048576"

# Formats of root filesystem images.
IMAGE_FSTYPES += "ext4"
RECOVERY_IMAGE = "0"

KERNEL_BASE = "0x80000000"
KERNEL_TAGS_OFFSET = "0x1e00000"
KERNEL_CONFIG = "${@['vendor/qti-quin-gvm-perf_defconfig', 'vendor/qti-quin-gvm_defconfig'][d.getVar('VARIANT', True) == ('' or 'debug')]}"
KERNEL_CMD_PARAMS = " "
KERNEL_IMAGETYPE = "Image-dtb"

IMAGE_EXT4_EXTRA_OPTIONS = "${@bb.utils.contains('DISTRO_FEATURES','ro-rootfs',' -J -b 1024 ','',d)}"

IMAGE_FEATURES_append = " read-only-rootfs"

MACHINE_FEATURES += "qti-core qti-audio qti-bluetooth qti-data qti-display qti-extra qti-multimedia qti-camera qti-graphics qti-security qti-vnw"
```

## meta-qti-base/conf/machine/sa6155.conf
```bitbake
#@TYPE: Machine
#@NAME: sa6155
#@DESCRIPTION: Machine configuration for QTI sa6155

BASEMACHINE ?= "sa6155"
include conf/machine/include/auto-common.inc

# EMMC TARGET TO SUPPORT 64-bit kernel
DEFAULTTUNE = "aarch64"
MACHINE_FEATURES += "dt-overlay"

# Sizes for EXT4 (in bytes)
SYSTEM_SIZE_EXT4 ?= "100000000"
SYSTEMRW_SIZE_EXT4 ?= "8388608"
USERDATA_SIZE_EXT4 ?= "2000000000"
CACHE_SIZE_EXT4 ?= "80000000"

# Formats of root filesystem images.
IMAGE_FSTYPES += "ext4"
RECOVERY_IMAGE = "0"

KERNEL_BASE = "0x80000000"
KERNEL_TAGS_OFFSET = "0x1e00000"
KERNEL_CONFIG = "${@['vendor/sdmsteppe-auto-perf_defconfig', 'vendor/sdmsteppe-auto_defconfig'][d.getVar('VARIANT', True) == ('' or 'debug')]}"
KERNEL_CMD_PARAMS = "console=ttyMSM0,115200n8 earlycon=msm_geni_serial,0x880000 androidboot.hardware=qcom androidboot.console=ttyMSM0 androidboot.memcg=1 lpm_levels.sleep_disabled=1 video=vfb:640x400,bpp=32,memsize=3072000 msm_rtb.filter=0x237 service_locator.enable=1 androidboot.usbcontroller=a600000.dwc3 androidboot.selinux=permissive buildvariant=userdebug rootfstype=ext4 rw rootwait firmware_class.path=/firmware/image/ "
KERNEL_CMD_PARAMS_append = " fsck.repair=yes "
KERNEL_CMD_PARAMS_append = "${@bb.utils.contains('DISTRO_FEATURES', 'early_init', 'early_userspace ', '', d)}"
KERNEL_CMD_PARAMS_remove = "${@bb.utils.contains_any('VARIANT', 'perf user', 'console=ttyMSM0,115200n8', '', d)}"
KERNEL_CMD_PARAMS_remove = "${@bb.utils.contains_any('VARIANT', 'perf user', 'earlycon=msm_geni_serial,0x880000', '', d)}"
KERNEL_CMD_PARAMS_remove = "${@bb.utils.contains_any('VARIANT', 'perf user', 'androidboot.console=ttyMSM0', '', d)}"
# Workaround for current serial driver
KERNEL_CMD_PARAMS_append = "${@bb.utils.contains('VARIANT', 'debug', ' quiet systemd.log_target=null ', '', d)}"
KERNEL_CMD_PARAMS_remove = "${@bb.utils.contains('IMAGE_FEATURES', 'read-only-rootfs', 'rw', '', d)}"
KERNEL_IMAGETYPE = "Image-dtb"

IMAGE_FEATURES_append = " read-only-rootfs"

MACHINE_FEATURES += "qti-core qti-audio qti-bluetooth qti-data qti-display qti-extra qti-multimedia qti-camera qti-graphics qti-security qti-vnw qti-wlan qti-tools"
```

## meta-qti-base/conf/machine/sa8155.conf
```bitbake
#@TYPE: Machine
#@NAME: sa8155
#@DESCRIPTION: Machine configuration for QTI sa8155

BASEMACHINE ?= "sa8155"
include conf/machine/include/auto-common.inc

# EMMC TARGET TO SUPPORT 64-bit kernel
DISTRO ??= "automotive"
DEFAULTTUNE = "aarch64"
MACHINE_FEATURES += "dt-overlay"

# Sizes for EXT4 (in bytes)
SYSTEM_SIZE_EXT4 ?= "100000000"
SYSTEMRW_SIZE_EXT4 ?= "8388608"
USERDATA_SIZE_EXT4 ?= "2000000000"
CACHE_SIZE_EXT4 ?= "80000000"

# Formats of root filesystem images.
IMAGE_FSTYPES += "ext4"
RECOVERY_IMAGE = "0"

# For dm-verity
ROOT_DEVICE = "/dev/sda6"

# if is "/dev/dm-0", dm-verity enabled on ${ROOT_DEVICE}
# if is ${ROOT_DEVICE}, no dm-verity
#KERNEL_ROOTDEVICE ?= "/dev/dm-0"
KERNEL_ROOTDEVICE ?= "${ROOT_DEVICE}"

KERNEL_BASE = "0x80000000"
KERNEL_TAGS_OFFSET = "0x1e00000"
KERNEL_CONFIG = "${@['vendor/sa8155-perf_defconfig', 'vendor/sa8155_defconfig'][d.getVar('VARIANT', True) == ('' or 'debug')]}"
KERNEL_CMD_PARAMS = "console=ttyMSM0,115200n8 earlycon=msm_geni_serial,0xa90000 androidboot.hardware=qcom androidboot.console=ttyMSM0 androidboot.memcg=1 lpm_levels.sleep_disabled=1 video=vfb:640x400,bpp=32,memsize=3072000 msm_rtb.filter=0x237 service_locator.enable=1 androidboot.usbcontroller=a600000.dwc3 androidboot.selinux=permissive androidboot.slot_suffix=_a buildvariant=userdebug root=${KERNEL_ROOTDEVICE} rootfstype=ext4 rw rootwait firmware_class.path=/firmware/image/ "
KERNEL_CMD_PARAMS_append = " fsck.repair=yes "
KERNEL_CMD_PARAMS_remove = "${@bb.utils.contains_any('VARIANT', 'perf user', 'console=ttyMSM0,115200n8', '', d)}"
KERNEL_CMD_PARAMS_remove = "${@bb.utils.contains_any('VARIANT', 'perf user', 'earlycon=msm_geni_serial,0xa90000', '', d)}"
KERNEL_CMD_PARAMS_remove = "${@bb.utils.contains_any('VARIANT', 'perf user', 'androidboot.console=ttyMSM0', '', d)}"
KERNEL_CMD_PARAMS_remove = "${@bb.utils.contains('IMAGE_FEATURES', 'read-only-rootfs', 'rw', '', d)}"
KERNEL_IMAGETYPE = "Image-dtb"

IMAGE_EXT4_EXTRA_OPTIONS = "${@bb.utils.contains('DISTRO_FEATURES','ro-rootfs',' -J -b 1024 ','',d)}"

DISTRO_FEATURES_append = " ab-boot-support"
IMAGE_FEATURES_append = " read-only-rootfs"
```
