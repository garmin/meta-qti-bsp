## conf/machine/qcs605-64.conf
```bitbake
#@TYPE: Machine
#@NAME: QCS605-64
#@DESCRIPTION: Machine configuration for QTI QCS605 64bit

require conf/machine/include/qcs605.inc


KERNEL_IMAGETYPE = "Image.gz-dtb"

KERNEL_DTS_NAME = "qcs605"
KERNEL_BASE = "0x80000000"
KERNEL_TAGS_OFFSET = "0x81900000"

KERNEL_CONFIG = "${@['sdm670-perf_defconfig', 'sdm670_defconfig'][d.getVar('VARIANT', True) == ('' or 'debug')]}"

KERNEL_CMD_PARAMS = "console=ttyMSM0,115200n8 earlycon=msm_geni_serial,0xA84000 androidboot.hardware=qcom androidboot.console=ttyMSM0 video=vfb:640x400,bpp=32,memsize=3072000 msm_rtb.filter=0x237 ehci-hcd.park=3 lpm_levels.sleep_disabled=1 service_locator.enable=1 firmware_class.path=/lib/firmware/updates"

KERNEL_CMD_PARAMS_remove = "${@bb.utils.contains_any('VARIANT', 'perf user', 'console=ttyMSM0,115200,n8 androidboot.console=ttyMSM0', '', d)}"

# readonly-rootfs
DISTRO_FEATURES_append = " ro-rootfs"

# Use systemd init manager.
DISTRO_FEATURES_remove = "sysvinit"
DISTRO_FEATURES_append = " systemd"
DISTRO_FEATURES_BACKFILL_CONSIDERED += "sysvinit"
VIRTUAL-RUNTIME_dev_manager = "udev"
VIRTUAL-RUNTIME_init_manager = "systemd"

#enable selinux
DISTRO_FEATURES_append = " selinux"
DEFAULT_ENFORCING = "enforcing"

# enable audio as a loadable kernel module
DISTRO_FEATURES_append = " audio-dlkm"

# Change Image features for systemd.
IMAGE_DEV_MANAGER = "udev"
IMAGE_INIT_MANAGER = "systemd"
IMAGE_INITSCRIPTS = ""

# Disable journalling for RO rootfs. Set the block size to 1024.
IMAGE_EXT4_EXTRA_OPTIONS = "${@bb.utils.contains('DISTRO_FEATURES','ro-rootfs',' -J -b 1024 ','',d)}"

# Multilib configuration
# This sets any packages preprended with lib32- to be built with
# the armv7a tuning (32 bit) instead of 64 bit aarch.
require conf/multilib.conf
MULTILIBS = "multilib:lib32"
DEFAULTTUNE_virtclass-multilib-lib32 = "armv7ahf-neon"
TARGET_VENDOR_virtclass-multilib-lib32="-oe"
```

## conf/machine/qcs605.conf
```bitbake
#@TYPE: Machine
#@NAME: QCS605
#@DESCRIPTION: Machine configuration for QTI QCS605

require conf/machine/include/qcs605.inc

DEFAULTTUNE = "armv7ahf-neon"

KERNEL_IMAGETYPE = "zImage-dtb"

KERNEL_DTS_NAME = "qcs605"
KERNEL_BASE = "0x80000000"
KERNEL_TAGS_OFFSET = "0x81900000"

KERNEL_CONFIG = "${@['sdm670-perf_defconfig', 'sdm670_defconfig'][d.getVar('VARIANT', True) == ('' or 'debug')]}"

KERNEL_CMD_PARAMS = "console=ttyMSM0,115200n8 earlycon=msm_geni_serial,0xA84000 androidboot.hardware=qcom androidboot.console=ttyMSM0 video=vfb:640x400,bpp=32,memsize=3072000 msm_rtb.filter=0x237 ehci-hcd.park=3 lpm_levels.sleep_disabled=1 service_locator.enable=1 androidboot.selinux=permissive firmware_class.path=/lib/firmware/updates"
KERNEL_CMD_PARAMS_remove = "${@bb.utils.contains_any('VARIANT', 'perf user', 'console=ttyMSM0,115200,n8 androidboot.console=ttyMSM0', '', d)}"

# readonly-rootfs
DISTRO_FEATURES_append = " ro-rootfs"
# Use systemd init manager.
DISTRO_FEATURES_remove = "sysvinit"
DISTRO_FEATURES_append = " systemd"
DISTRO_FEATURES_BACKFILL_CONSIDERED += "sysvinit"
VIRTUAL-RUNTIME_dev_manager = "udev"
VIRTUAL-RUNTIME_init_manager = "systemd"


# enable audio as a loadable kernel module
DISTRO_FEATURES_append = " audio-dlkm"

# Change Image features for systemd.
IMAGE_DEV_MANAGER = "udev"
IMAGE_INIT_MANAGER = "systemd"
IMAGE_INITSCRIPTS = ""

# Disable journalling for RO rootfs. Set the block size to 1024.
IMAGE_EXT4_EXTRA_OPTIONS = "${@bb.utils.contains('DISTRO_FEATURES','ro-rootfs',' -J -b 1024 ','',d)}"

#Need for compiling UEFI for aarch64
require conf/multilib.conf
MULTILIBS = "multilib:lib64"
DEFAULTTUNE_virtclass-multilib-lib64 = "aarch64"
```

## conf/machine/sdm710.conf
```bitbake
#@TYPE: Machine
#@NAME: SDM710
#@DESCRIPTION: Machine configuration for QTI MTP with SDM710

require conf/machine/include/sdm710.inc

KERNEL_IMAGETYPE = "Image.gz-dtb"
KERNEL_DTS_NAME = "warlock"
KERNEL_BASE = "0x80000000"
KERNEL_TAGS_OFFSET = "0x83280000"
KERNEL_CONFIG = "${@['okl4_virtual_platform_sdm710_defconfig', 'okl4_virtual_platform_sdm710_defconfig'][d.getVar('VARIANT', True) == ('' or 'debug')]}"
LLVM_VERSION = "6.0"

KERNEL_CMD_PARAMS = "noinitrd ro console=ttyMSM0,115200n8 earlycon=msm_geni_serial,0xA90000 androidboot.hardware=qcom androidboot.console=ttyMSM0 video=vfb:640x400,bpp=32,memsize=3072000 msm_rtb.filter=0x237 ehci-hcd.park=3 lpm_levels.sleep_disabled=1 service_locator.enable=1 androidboot.configfs=true androidboot.usbcontroller=a600000.dwc3 swiotlb=1 firmware_class.path=/vendor/firmware_mnt/image"

DISTRO_FEATURES_append = " ro-rootfs"
```

## conf/machine/sdmsteppe.conf
```bitbake
#@TYPE: Machine
#@NAME: sdmsteppe
#@DESCRIPTION: Machine configuration for QTI sdmsteppe 32bit

require  ${COREBASE}/meta-qti-bsp/conf/machine/sdm-generic32.conf

BASEMACHINE = "sdmsteppe"

DEFAULTTUNE = "armv7ahf-neon"

PREFERRED_PROVIDER_virtual/kernel = "linux-msm"
PREFERRED_VERSION_linux-msm = "4.14"

# Kernel to build for a different arch than default tune
TARGET_KERNEL_ARCH = "aarch64"

KERNEL_DTS_NAME = "sm6150-qrd"
KERNEL_BASE = "0x80000000"
KERNEL_TAGS_OFFSET = "0x81E00000"
KERNEL_IMAGETYPE = "Image.gz-dtb"
KERNEL_CONFIG = "${@['vendor/sdmsteppe-perf_defconfig', 'vendor/sdmsteppe_defconfig'][d.getVar('VARIANT', True) == ('' or 'debug')]}"

# Defined 64bit multilib environment to setup toolchain to compile 64bit kernel
require conf/multilib.conf
MULTILIBS = "multilib:lib64"
DEFAULTTUNE_virtclass-multilib-lib64 = "aarch64"
TARGET_VENDOR_virtclass-multilib-lib64="-oe"

# Enable selinux
DISTRO_FEATURES_append = " selinux"
DEFAULT_ENFORCING = "permissive"

# readonly-rootfs
DISTRO_FEATURES_append = " ro-rootfs"

#Disable journalling for RO rootfs. Set the block size to 4096.
IMAGE_EXT4_EXTRA_OPTIONS = "${@bb.utils.contains('DISTRO_FEATURES','ro-rootfs',' -J -b 4096 ','',d)}"


# Userspace needs below given macro to support libion after kernel 4.12.
TARGET_CFLAGS += " -DTARGET_ION_ABI_VERSION=2"
TARGET_CXXFLAGS += " -DTARGET_ION_ABI_VERSION=2"
```

## conf/machine/sdxpoorwills.conf
```bitbake
#@TYPE: Machine
#@NAME: SDXPOORWILLS
#@DESCRIPTION: Machine configuration for QTI sdxpoorwills

require conf/machine/include/sdxpoorwills.inc

PREFERRED_PROVIDER_virtual/kernel ?= "linux-msm-4.9"

KERNEL_IMAGETYPE = "zImage-dtb"
KERNEL_DTS_NAME = "sdxpoorwills"
KERNEL_BASE = "0x80000000"
KERNEL_TAGS_OFFSET = "0x82000000"
KERNEL_DEFCONFIG = "sdxpoorwills_defconfig"
KERNEL_PERF_DEFCONFIG = "sdxpoorwills-perf_defconfig"

# Pull in security flags
require ${COREBASE}/meta-qti-bsp/conf/distro/include/security_flags.inc
KERNEL_CMD_PARAMS = "noinitrd rw rootwait console=ttyMSM0,115200,n8 earlycon=msm_serial_dm,0x831000 no_console_suspend=1 androidboot.hardware=qcom androidboot.console=ttyMSM0"
```

## conf/machine/sdxprairie.conf
```bitbake
#@TYPE: Machine
#@NAME: SDXPRAIRIE
#@DESCRIPTION: Machine configuration for QTI sdxprairie

require conf/machine/include/sdxprairie.inc

KERNEL_IMAGETYPE = "zImage-dtb"
KERNEL_DTS_NAME = "sdxprairie"
KERNEL_BASE = "0x80000000"
KERNEL_TAGS_OFFSET = "0x82000000"

KERNEL_CONFIG = "${@['sdxprairie-perf_defconfig', 'sdxprairie_defconfig'][d.getVar('VARIANT', True) == ('' or 'debug')]}"

KERNEL_CMD_PARAMS = "noinitrd ro rootwait console=ttyMSM0,115200,n8 androidboot.hardware=qcom msm_rtb.filter=0x37 androidboot.console=ttyMSM0 lpm_levels.sleep_disabled=1  firmware_class.path=/lib/firmware/updates"
KERNEL_CMD_PARAMS_remove = "${@bb.utils.contains_any('VARIANT', 'perf user', 'console=ttyMSM0,115200,n8 androidboot.console=ttyMSM0', '', d)}"

LLVM_VERSION = "6.0"
```

## meta-qti-advance/conf/layer.conf
```bitbake
BBFILES += "${LAYERDIR}/recipes/*/*.bb ${LAYERDIR}/recipes/*/*.bbappend ${LAYERDIR}/recipes-*/*/*.bb ${LAYERDIR}/recipes-*/*/*.bbappend"
BBPATH .= ":${LAYERDIR}"
BBFILE_COLLECTIONS += "qti-advance"
BBFILE_PRIORITY_qti-advance = "12"
BBFILE_PATTERN_qti-advance := "^${LAYERDIR}/"
```

## meta-qti-agl/conf/distro/auto-agl.conf
```bitbake
#require conf/distro/include/qti-agl.inc
require ${QTI_METAPATH_BASE}/conf/distro/auto.conf

DISTRO_FEATURES_append = " qti-bluetooth qti-wlan"

PRODUCT = "${BASEMACHINE}agl"

BBMASK .= "|meta-qti-bsp/meta-qti-agl/recipes-*"
```

## meta-qti-agl/conf/distro/auto-gvm-agl.conf
```bitbake
#require conf/distro/include/qti-agl.inc
require ${QTI_METAPATH_BASE}/conf/distro/auto-gvm.conf

BBMASK .= "|meta-qti-bsp/meta-qti-agl/recipes-*"
```

## meta-qti-agl/conf/distro/automotive.conf
```bitbake
require conf/distro/poky-agl.conf
require conf/include/base-agl.inc
require conf/include/agl-appfw-smack.inc
require conf/include/agl-pulseaudio.inc
require ${QTI_METAPATH_BASE}/conf/distro/automotive.conf

# Enable agl hmi framework
DISTRO_FEATURES_append = " agl-hmi-framework"

# reset ROOT_HOME in conf/include/agl-appfw-smack.inc
ROOT_HOME = "/home/root"

# Add buildname to fix error
USER_CLASSES = "buildstats buildname image-mklibs"

# TCLIBCAPPEND is set to empty in conf/distro/poky.conf, so $TMPDIR is $TOPDIR/tmp
# Reset the value as meta/conf/distro/defaultsetup.conf
TCLIBCAPPEND = "-${TCLIBC}"

# Mask unnecessary recipes to fix build error
BBMASK .= "|meta-agl/meta-agl-profile-graphical/recipes-graphics/wayland/weston_6.0.0.bbappend"
BBMASK .= "|meta-agl/meta-agl-profile-core/recipes-test/freetype/freetype_2.9.1.bbappend"
BBMASK .= "|meta-qti-bsp/meta-qti-extra/recipes-audio/pulseaudio/pulseaudio_%.bbappend"
BBMASK .= "|meta-agl/meta-agl-profile-graphical/recipes-graphics/wayland/weston-init.bbappend"
BBMASK .= "|meta-agl/meta-agl-profile-graphical/recipes-graphics/wayland/weston_5.0.0.bbappend"
BBMASK .= "|meta-agl/meta-agl-profile-core/recipes-connectivity/connman/"
BBMASK .= "|meta-agl-devel/meta-pipewire/recipes-security/security-manager/security-manager_%.bbappend"
```

## meta-qti-agl/conf/distro/include/qti-agl.inc
```bitbake
require conf/distro/poky-agl.conf
require conf/include/base-agl.inc
require conf/include/agl-appfw-smack.inc
require conf/include/agl-pulseaudio.inc

# Enable agl hmi framework
DISTRO_FEATURES_append = " agl-hmi-framework"

# reset ROOT_HOME in conf/include/agl-appfw-smack.inc
ROOT_HOME = "/home/root"

# Add buildname to fix error
USER_CLASSES = "buildstats buildname image-mklibs"

# TCLIBCAPPEND is set to empty in conf/distro/poky.conf, so $TMPDIR is $TOPDIR/tmp
# Reset the value as meta/conf/distro/defaultsetup.conf
TCLIBCAPPEND = "-${TCLIBC}"
```

## meta-qti-agl/conf/layer.conf
```bitbake
BBFILES += "${LAYERDIR}/recipes/*/*.bb ${LAYERDIR}/recipes/*/*.bbappend ${LAYERDIR}/recipes-*/*/*.bb ${LAYERDIR}/recipes-*/*/*.bbappend"
BBPATH .= ":${LAYERDIR}"
BBFILE_COLLECTIONS += "qti-agl"
BBFILE_PRIORITY_qti-agl = "11"
BBFILE_PATTERN_qti-agl := "^${LAYERDIR}/"
QTI_METAPATH_AGL := '${@os.path.normpath("${LAYERDIR}/")}'
```

## meta-qti-base/conf/distro/auto-gvm.conf
```bitbake
require conf/distro/include/auto-common.inc

DISTRO_NAME = "auto gvm"

DISTRO_FEATURES_append= " q-hypervisor"

DISTRO_FEATURES_append = " qti-core qti-audio qti-bluetooth qti-data qti-display qti-extra qti-multimedia qti-camera qti-graphics qti-security qti-vnw" 
```

## meta-qti-base/conf/distro/auto-ivi.conf
```bitbake
require conf/distro/include/auto-common.inc

DISTRO_NAME = "auto ivi"

DISTRO_FEATURES_append = " early_init"

PRODUCT = "sa8155ivi"

DISTRO_FEATURES_append = " audio"
```

## meta-qti-base/conf/distro/auto-qdrive.conf
```bitbake
require conf/distro/include/auto-common.inc

DISTRO_NAME = "auto qdrive"

PRODUCT = "sa8155qdrive"

DISTRO_FEATURES_append = " qti-core qti-audio qti-bluetooth qti-data qti-display qti-extra qti-multimedia qti-camera qti-graphics qti-security qti-vnw qti-tools qti-ros qti-qdrive qti-location"

# enable protobuf for location engine hub for message passing
DISTRO_FEATURES_append = " locenghub-proto"
```

## meta-qti-base/conf/distro/auto.conf
```bitbake
require conf/distro/include/auto-common.inc

DISTRO_NAME = "auto"

DISTRO_FEATURES_append = " qti-core qti-audio qti-data qti-display qti-extra qti-multimedia qti-camera qti-graphics qti-security qti-vnw qti-tools qti-lxc"
```

## meta-qti-base/conf/distro/automotive.conf
```bitbake
BASEDISTRO ?= "msm"
include conf/distro/msm.conf

DISTRO_NAME = "automotive"
DISTROOVERRIDES =. "automotive:"

PRODUCT = "automotive"

DEPLOY_NAME_BASE="${BASEMACHINE}-automotive"

# Support systemd-user-session
DISTRO_FEATURES_append = " pam"

# Display
DISTRO_FEATURES_append = " wayland"

#Disable ssd listener
DISTRO_FEATURES_append = " no-ssd-listener-support"

# Use synergy, disable bluez
DISTRO_FEATURES_BACKFILL_CONSIDERED += "bluez5 bluetooth"

#Enable persist-image
DISTRO_FEATURES_append = " persist-image "
PERSIST_IMAGE_ROOTFS_SIZE ?= "128M"

DISTRO_FEATURES += "early-eth"

DISTRO_FEATURES_append = " ab-boot-support"

# Use systemd init manager.
DISTRO_FEATURES_append = " systemd"
DISTRO_FEATURES_BACKFILL_CONSIDERED += "sysvinit"
VIRTUAL-RUNTIME_dev_manager = "udev"
VIRTUAL-RUNTIME_init_manager = "systemd"

DISTRO_FEATURES_append = " ipa3"

IMAGE_EXT4_EXTRA_OPTIONS = "${@bb.utils.contains('DISTRO_FEATURES','ro-rootfs',' -J -b 1024 ','',d)}"

INCOMPATIBLE_LICENSE = "GPL-3.0 LGPL-3.0 AGPL-3.0"

include ${DISTRO_INC_FILES}
```
