## meta-qti-base/conf/machine/sa8195.conf
```bitbake
#@TYPE: Machine
#@NAME: sa8195
#@DESCRIPTION: Machine configuration for QTI sa8195

BASEMACHINE ?= "sa8195"
include conf/machine/include/auto-common.inc

# EMMC TARGET TO SUPPORT 64-bit kernel
DEFAULTTUNE = "aarch64"
MACHINE_FEATURES += "dt-overlay"

# Sizes for EXT4 (in bytes)
SYSTEM_SIZE_EXT4 ?= "100000000"
SYSTEMRW_SIZE_EXT4 ?= "8388608"
USERDATA_SIZE_EXT4 ?= "2000000000"
CACHE_SIZE_EXT4 ?= "80000000"

# Formats of root filesystem images.
IMAGE_FSTYPES += "ext4"
RECOVERY_IMAGE = "0"

KERNEL_BASE = "0x80000000"
KERNEL_TAGS_OFFSET = "0x1e00000"
KERNEL_CONFIG = "${@['vendor/sdmshrike-perf_defconfig', 'vendor/sdmshrike_defconfig'][d.getVar('VARIANT', True) == ('' or 'debug')]}"
KERNEL_CMD_PARAMS = "console=ttyMSM0,115200n8 earlycon=msm_geni_serial,0xa90000 androidboot.hardware=qcom androidboot.memcg=1 lpm_levels.sleep_disabled=1 video=vfb:640x400,bpp=32,memsize=3072000 msm_rtb.filter=0x237 service_locator.enable=1 androidboot.usbcontroller=a600000.dwc3 androidboot.selinux=permissive buildvariant=userdebug rootfstype=ext4 rw rootwait firmware_class.path=/firmware/image/ "
KERNEL_CMD_PARAMS_append = " fsck.repair=yes "
KERNEL_CMD_PARAMS_remove = "${@bb.utils.contains_any('VARIANT', 'perf user', 'console=ttyMSM0,115200n8', '', d)}"
KERNEL_CMD_PARAMS_remove = "${@bb.utils.contains_any('VARIANT', 'perf user', 'earlycon=msm_geni_serial,0xa90000', '', d)}"
KERNEL_CMD_PARAMS_remove = "${@bb.utils.contains('IMAGE_FEATURES', 'read-only-rootfs', 'rw', '', d)}"
KERNEL_CMD_PARAMS_append = "${@bb.utils.contains('DISTRO_FEATURES', 'lxc', ' androidboot.android_dt_dir=/skip/ ', '', d)}"
KERNEL_CMD_PARAMS_append = "${@bb.utils.contains('DISTRO_FEATURES', 'lxc', 'androidboot.console=tty30', '', d)}"
#KERNEL_IMAGETYPE = "Image-dtb"
KERNEL_IMAGETYPE = "Image.gz-dtb"

KERNEL_CMD_PARAMS_append = "${@bb.utils.contains('DISTRO_FEATURES', 'dm_verity', 'dmname=disabled version data_device hash_device data_block_size hash_block_size number_of_data_blocks hash_start_block algorithm digest salt opt=restart_on_corruption', '', d)}"

IMAGE_FEATURES_append = " read-only-rootfs"

MACHINE_FEATURES += "qti-core qti-audio qti-bluetooth qti-data qti-display qti-extra qti-multimedia qti-camera qti-graphics qti-security qti-vnw qti-wlan qti-tools"
```

## meta-qti-clang/conf/layer.conf
```bitbake
BBFILES += "${LAYERDIR}/recipes/*/*.bb ${LAYERDIR}/recipes/*/*.bbappend ${LAYERDIR}/recipes-*/*/*.bb ${LAYERDIR}/recipes-*/*/*.bbappend"
BBPATH .= ":${LAYERDIR}"
BBFILE_COLLECTIONS += "qti-clang"
BBFILE_PRIORITY_qti-clang = "15"
BBFILE_PATTERN_qti-clang := "^${LAYERDIR}/"
```

## meta-qti-extra/conf/layer.conf
```bitbake
BBFILES += "${LAYERDIR}/recipes/*/*.bb ${LAYERDIR}/recipes/*/*.bbappend ${LAYERDIR}/recipes-*/*/*.bb ${LAYERDIR}/recipes-*/*/*.bbappend"
BBPATH .= ":${LAYERDIR}"
BBFILE_COLLECTIONS += "qti-extra"
BBFILE_PRIORITY_qti-extra = "12"
BBFILE_PATTERN_qti-extra := "^${LAYERDIR}/"
```

## meta-qti-ros/conf/layer.conf
```bitbake
BBFILES += "${LAYERDIR}/recipes/*/*.bb ${LAYERDIR}/recipes/*/*.bbappend ${LAYERDIR}/recipes-*/*/*.bb ${LAYERDIR}/recipes-*/*/*.bbappend"
BBPATH .= ":${LAYERDIR}"
BBFILE_COLLECTIONS += "qti-ros"
BBFILE_PRIORITY_qti-ros = "11"
BBFILE_PATTERN_qti-ros := "^${LAYERDIR}/"
```

## meta-qti-sdllvm/conf/layer.conf
```bitbake
BBFILES += "${LAYERDIR}/recipes/*/*.bb ${LAYERDIR}/recipes/*/*.bbappend ${LAYERDIR}/recipes-*/*/*.bb ${LAYERDIR}/recipes-*/*/*.bbappend"
BBPATH .= ":${LAYERDIR}"
BBFILE_COLLECTIONS += "qti-sdllvm"
BBFILE_PRIORITY_qti-sdllvm = "15"
BBFILE_PATTERN_qti-sdllvm := "^${LAYERDIR}/"
```

## meta-qti-upstream/conf/layer.conf
```bitbake
BBFILES += "${LAYERDIR}/recipes/*/*.bb ${LAYERDIR}/recipes/*/*.bbappend ${LAYERDIR}/recipes-*/*/*.bb ${LAYERDIR}/recipes-*/*/*.bbappend"
BBPATH .= ":${LAYERDIR}"
BBFILE_COLLECTIONS += "qti-upstream"
BBFILE_PRIORITY_qti-upstream = "9"
BBFILE_PATTERN_qti-upstream := "^${LAYERDIR}/"
```
